## CMakeLists.txt
```
# Copyright (C) 2019 Intel Corporation.  All rights reserved.
# SPDX-License-Identifier: Apache-2.0 WITH LLVM-exception

cmake_minimum_required(VERSION 3.14)

find_package(Zephyr REQUIRED HINTS $ENV{ZEPHYR_BASE})
project(wamr)

enable_language (ASM)

set (WAMR_BUILD_PLATFORM "zephyr")

# Build as X86_32 by default, change to "AARCH64[sub]", "ARM[sub]", "THUMB[sub]", "MIPS" or "XTENSA"
# if we want to support arm, thumb, mips or xtensa
if (NOT DEFINED WAMR_BUILD_TARGET)
  set (WAMR_BUILD_TARGET "X86_32")
endif ()

if (NOT DEFINED WAMR_BUILD_INTERP)
  # Enable Interpreter by default
  set (WAMR_BUILD_INTERP 1)
endif ()

if (NOT DEFINED WAMR_BUILD_AOT)
  # Enable AOT by default.
  set (WAMR_BUILD_AOT 1)
endif ()

if (NOT DEFINED WAMR_BUILD_LIBC_BUILTIN)
  # Enable libc builtin support by default
  set (WAMR_BUILD_LIBC_BUILTIN 1)
endif ()

if (NOT DEFINED WAMR_BUILD_LIBC_WASI)
  # Disable libc wasi support by default, in the future, 
  # it can be enabled if libc wasi file/socket/lock support is ready on Zephyr platform
  set (WAMR_BUILD_LIBC_WASI 0)
endif ()

if (WAMR_BUILD_TARGET STREQUAL "RISCV64_LP64" OR WAMR_BUILD_TARGET STREQUAL "RISCV32_ILP32")
  # Default RISC-V to the fast interpreter unless overridden via -D.
  if (NOT DEFINED WAMR_BUILD_FAST_INTERP)
    set (WAMR_BUILD_FAST_INTERP 1)
  endif ()
endif ()

# Override the global heap usage
if (NOT DEFINED WAMR_BUILD_GLOBAL_HEAP_POOL)
  set (WAMR_BUILD_GLOBAL_HEAP_POOL 1)
endif ()

# Override the global heap size for small devices
if (NOT DEFINED WAMR_BUILD_GLOBAL_HEAP_SIZE)
  set (WAMR_BUILD_GLOBAL_HEAP_SIZE 131072) # 128 KB
endif ()

# Benchmark identity emitted in each CSV row; set by build_and_run.sh.
if (NOT DEFINED BENCH_NAME)
  set (BENCH_NAME "wasm")
endif ()
if (NOT DEFINED BENCH_MODE)
  set (BENCH_MODE "interp")
endif ()
if (NOT DEFINED BENCH_PLATFORM)
  set (BENCH_PLATFORM "thumbv8")
endif ()

if (BENCH_MODE STREQUAL "native")
  # Native baseline: bench_main straight on the CPU, no WAMR.
  if (NOT DEFINED BENCH_SRC)
    message (FATAL_ERROR "BENCH_MODE=native requires -DBENCH_SRC=benchmarks/<bench>/main.c")
  endif ()
  target_sources(app PRIVATE
                 src/native_provider.c
                 ${BENCH_SRC})
else ()
  set (WAMR_ROOT_DIR ${CMAKE_CURRENT_SOURCE_DIR}/../wasm-micro-runtime/)
  include (${WAMR_ROOT_DIR}/build-scripts/runtime_lib.cmake)
  target_sources(app PRIVATE
                 ${WAMR_RUNTIME_LIB_SOURCE}
                 src/main.c)
endif ()

target_include_directories(app PRIVATE src/wasm-src)
target_compile_definitions(app PRIVATE
                           BENCH_NAME="${BENCH_NAME}"
                           BENCH_MODE="${BENCH_MODE}"
                           BENCH_PLATFORM="${BENCH_PLATFORM}")

# Suppress -Wtype-limits warnings originating from Zephyr's own headers
# (e.g. net_if.h "comparison is always true due to limited range of data type").
# Pulled in transitively via platform_internal.h → net_pkt.h → net_if.h.
target_compile_options(app PRIVATE -Wno-type-limits)
```

## prj.conf
```kconfig
# Copyright (C) 2019 Intel Corporation.  All rights reserved.
# SPDX-License-Identifier: Apache-2.0 WITH LLVM-exception

CONFIG_STACK_SENTINEL=y
CONFIG_PRINTK=y
CONFIG_LOG=y
CONFIG_LOG_BUFFER_SIZE=4096
CONFIG_THREAD_RUNTIME_STATS=y

CONFIG_MAIN_STACK_SIZE=16384
CONFIG_SPEED_OPTIMIZATIONS=y
# used only for rpi_pico2_thumb m33 core
# CONFIG_FPU=y
```

## src/main.c
```c
/*
 * Copyright (C) 2019 Intel Corporation.  All rights reserved.
 * SPDX-License-Identifier: Apache-2.0 WITH LLVM-exception
 */

#include <stdlib.h>
#include <string.h>
#include <stdint.h>
#include "bh_platform.h"
#include "bh_assert.h"
#include "bh_log.h"
#include "wasm_export.h"
#include "zephyr/kernel.h"
#include "zephyr/syscalls/kernel.h"
#include "test_wasm.h"

#define CONFIG_GLOBAL_HEAP_BUF_SIZE WASM_GLOBAL_HEAP_SIZE
#define CONFIG_APP_STACK_SIZE 8192
#define CONFIG_APP_HEAP_SIZE 8192

#define CONFIG_MAIN_THREAD_STACK_SIZE 8192

/* Set at build time via -DBENCH_NAME / -DBENCH_MODE / -DBENCH_PLATFORM. */
#ifndef BENCH_NAME
#define BENCH_NAME "unknown"
#endif
#ifndef BENCH_MODE
#define BENCH_MODE "unknown"
#endif
#ifndef BENCH_PLATFORM
#define BENCH_PLATFORM "unknown"
#endif

#ifndef BENCH_ITERATIONS
#define BENCH_ITERATIONS 20
#endif

static void
bench_report(uint32 iter, uint64 cycles)
{
    uint64_t value_ns = k_cyc_to_ns_floor64((uint64_t)cycles);
    printf("%s,%s,%s,%u,%llu,%llu\n", BENCH_NAME, BENCH_MODE, BENCH_PLATFORM,
           iter, cycles, (unsigned long long)value_ns);
}

#if WASM_ENABLE_GLOBAL_HEAP_POOL != 0
static char global_heap_buf[CONFIG_GLOBAL_HEAP_BUF_SIZE] = { 0 };
#endif

void
iwasm_main(void *arg1, void *arg2, void *arg3)
{
    uint8 *wasm_file_buf = NULL;
    uint32 wasm_file_size;
    wasm_module_t wasm_module = NULL;
    wasm_module_inst_t wasm_module_inst = NULL;
    wasm_exec_env_t exec_env = NULL;
    wasm_function_inst_t func_main = NULL;
    wasm_function_inst_t bench_init = NULL;
    uint32 call_argv[1] = { 0 };
    RuntimeInitArgs init_args;
    char error_buf[128];
#if WASM_ENABLE_LOG != 0
    int log_verbose_level = 2;
#endif

    (void)arg1;
    (void)arg2;
    (void)arg3;

    memset(&init_args, 0, sizeof(RuntimeInitArgs));

#if WASM_ENABLE_GLOBAL_HEAP_POOL != 0
    init_args.mem_alloc_type = Alloc_With_Pool;
    init_args.mem_alloc_option.pool.heap_buf = global_heap_buf;
    init_args.mem_alloc_option.pool.heap_size = sizeof(global_heap_buf);
#elif (defined(CONFIG_COMMON_LIBC_MALLOC)            \
       && CONFIG_COMMON_LIBC_MALLOC_ARENA_SIZE != 0) \
    || defined(CONFIG_NEWLIB_LIBC)
    init_args.mem_alloc_type = Alloc_With_System_Allocator;
#else
#error "memory allocation scheme is not defined."
#endif

    if (!wasm_runtime_full_init(&init_args)) {
        printf("Init runtime environment failed.\n");
        return;
    }

#if WASM_ENABLE_LOG != 0
    bh_log_set_verbose_level(log_verbose_level);
#endif

    wasm_file_buf = (uint8 *)wasm_test_file;
    wasm_file_size = sizeof(wasm_test_file);

    if (!(wasm_module = wasm_runtime_load(wasm_file_buf, wasm_file_size,
                                          error_buf, sizeof(error_buf)))) {
        printf("%s\n", error_buf);
        goto fail1;
    }

    if (!(wasm_module_inst = wasm_runtime_instantiate(
              wasm_module, CONFIG_APP_STACK_SIZE, CONFIG_APP_HEAP_SIZE,
              error_buf, sizeof(error_buf)))) {
        printf("%s\n", error_buf);
        goto fail2;
    }

    func_main = wasm_runtime_lookup_function(wasm_module_inst, "bench_run");
    if (!func_main) {
        printf("Failed to lookup exported function bench_run\n");
        goto fail2;
    }

    bench_init = wasm_runtime_lookup_function(wasm_module_inst, "bench_init");
    if (!bench_init) {
        printf("Failed to lookup exported function bench_init\n");
        goto fail2;
    }

    exec_env =
        wasm_runtime_create_exec_env(wasm_module_inst, CONFIG_APP_STACK_SIZE);
    if (!exec_env) {
        printf("Create exec env failed\n");
        goto fail2;
    }

    printf("benchmark,mode,platform,iteration,value_cycles,value_ns\n");
    for(int i=0; i<BENCH_ITERATIONS; i++){
        if (!wasm_runtime_call_wasm(exec_env, bench_init, 0, call_argv)) {
            const char *exception = wasm_runtime_get_exception(wasm_module_inst);
            if (exception)
                printf("%s\n", exception);
        }
        uint32_t before = k_cycle_get_32();
        if (!wasm_runtime_call_wasm(exec_env, func_main, 0, call_argv)) {
            const char *exception = wasm_runtime_get_exception(wasm_module_inst);
            if (exception)
                printf("%s\n", exception);
        }
        uint32_t after = k_cycle_get_32();
        bench_report(i, after - before);
        k_sleep(K_SECONDS(1));
    }

    wasm_runtime_destroy_exec_env(exec_env);
    wasm_runtime_deinstantiate(wasm_module_inst);

fail2:
    wasm_runtime_unload(wasm_module);

fail1:
    wasm_runtime_destroy();
}

#define MAIN_THREAD_STACK_SIZE (CONFIG_MAIN_THREAD_STACK_SIZE)
#define MAIN_THREAD_PRIORITY 5

K_THREAD_STACK_DEFINE(iwasm_main_thread_stack, MAIN_THREAD_STACK_SIZE);
static struct k_thread iwasm_main_thread;

bool
iwasm_init(void)
{
    k_tid_t tid = k_thread_create(
        &iwasm_main_thread, iwasm_main_thread_stack, MAIN_THREAD_STACK_SIZE,
        iwasm_main, NULL, NULL, NULL, MAIN_THREAD_PRIORITY, 0, K_NO_WAIT);
    return tid ? true : false;
}

#if KERNEL_VERSION_NUMBER < 0x030400 /* version 3.4.0 */
void
main(void)
{
    iwasm_init();
}
#else
int
main(void)
{
    iwasm_init();
    return 0;
}
#endif
```

## src/native_provider.c
```c
/*
 * Copyright (C) 2019 Intel Corporation.  All rights reserved.
 * SPDX-License-Identifier: Apache-2.0 WITH LLVM-exception
 */

#include <stdint.h>
#include "zephyr/kernel.h"

#ifndef BENCH_NAME
#define BENCH_NAME "unknown"
#endif
#ifndef BENCH_MODE
#define BENCH_MODE "native"
#endif
#ifndef BENCH_PLATFORM
#define BENCH_PLATFORM "unknown"
#endif

#ifndef BENCH_ITERATIONS
#define BENCH_ITERATIONS 20
#endif

void bench_report(uint32_t iter, uint64_t cycles)
{
    uint64_t value_ns = k_cyc_to_ns_floor64((uint64_t)cycles);
    printf("%s,%s,%s,%u,%llu,%llu\n", BENCH_NAME, BENCH_MODE, BENCH_PLATFORM,
           iter, cycles, (unsigned long long)value_ns);
}

void bench_init(void);
void bench_run(void);

int main(void)
{
    printf("benchmark,mode,platform,iteration,value_cycles,value_ns\n");
    for (uint32_t i = 0; i < BENCH_ITERATIONS; i++) {
        bench_init();

        uint32_t before = k_cycle_get_32();
        bench_run();
        uint32_t after = k_cycle_get_32();

        bench_report(i, after - before);
        k_sleep(K_SECONDS(1));
    }
    return 0;
}
```
